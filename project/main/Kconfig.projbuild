## project/main/Kconfig.projbuild
```kconfig
menu "WiFi Configuration"
    choice ESP_WIFI_MODE
        prompt "Wifi Mode"
        default ESP_WIFI_MODE_STA
        config ESP_WIFI_MODE_STA
            bool "Station"
        config ESP_WIFI_MODE_AP
            bool "SoftAP"
    endchoice

    config ESP_WIFI_SSID
        string "WiFi SSID"
        default "myssid"
        help
            SSID (network name) for the project to connect to.

    config ESP_WIFI_PASSWORD
        string "WiFi Password"
        default "mypassword"
        help
            WiFi password (WPA or WPA2) for the project to use.
    
    if ESP_WIFI_MODE_STA
        choice ESP_WIFI_SAE_MODE
            prompt "WPA3 SAE mode selection"
            default ESP_WPA3_SAE_PWE_BOTH
            help
                Select mode for SAE as Hunt and Peck, H2E or both.
            config ESP_WPA3_SAE_PWE_HUNT_AND_PECK
                bool "HUNT AND PECK"
            config ESP_WPA3_SAE_PWE_HASH_TO_ELEMENT
                bool "H2E"
            config ESP_WPA3_SAE_PWE_BOTH
                bool "BOTH"
        endchoice

        config ESP_WIFI_PW_ID
            string "PASSWORD IDENTIFIER"
            depends on  ESP_WPA3_SAE_PWE_HASH_TO_ELEMENT|| ESP_WPA3_SAE_PWE_BOTH
            default ""
            help
                password identifier for SAE H2E

        config ESP_MAXIMUM_RETRY
            int "Maximum retry"
            default 5
            help
                Set the Maximum retry to avoid station reconnecting to the AP unlimited when the AP is really inexistent.

        choice ESP_WIFI_SCAN_AUTH_MODE_THRESHOLD
            prompt "WiFi Scan auth mode threshold"
            default ESP_WIFI_AUTH_WPA2_PSK
            help
                The weakest authmode to accept in the scan mode.
                This value defaults to ESP_WIFI_AUTH_WPA2_PSK incase password is present and ESP_WIFI_AUTH_OPEN is used.
                Please select ESP_WIFI_AUTH_WEP/ESP_WIFI_AUTH_WPA_PSK incase AP is operating in WEP/WPA mode.

            config ESP_WIFI_AUTH_OPEN
                bool "OPEN"
            config ESP_WIFI_AUTH_WEP
                bool "WEP"
            config ESP_WIFI_AUTH_WPA_PSK
                bool "WPA PSK"
            config ESP_WIFI_AUTH_WPA2_PSK
                bool "WPA2 PSK"
            config ESP_WIFI_AUTH_WPA_WPA2_PSK
                bool "WPA/WPA2 PSK"
            config ESP_WIFI_AUTH_WPA3_PSK
                bool "WPA3 PSK"
            config ESP_WIFI_AUTH_WPA2_WPA3_PSK
                bool "WPA2/WPA3 PSK"
            config ESP_WIFI_AUTH_WAPI_PSK
                bool "WAPI PSK"
        endchoice
    endif
    
    if ESP_WIFI_MODE_AP
        config ESP_WIFI_CHANNEL
            int "WiFi Channel"
            range 1 13
            default 1
            help
                WiFi channel (network channel) for the project to use.

        config ESP_MAX_STA_CONN
            int "Maximal STA connections"
            default 4
            help
                Max number of the STA connects to AP.
    endif
endmenu

menu "OTA Configuration"

    config PROJECT_FIRMWARE_UPGRADE_URL
        string "firmware upgrade url endpoint"
        default "https://192.168.0.3:8070/hello_world.bin"
        help
            URL of server which hosts the firmware
            image.

    config PROJECT_USE_CERT_BUNDLE
        bool "Enable certificate bundle"
        default y
        depends on MBEDTLS_CERTIFICATE_BUNDLE
        help
            Enable trusted root certificate bundle. This approach allows to have
            OTA updates functional with any public server without requirement
            to explicitly add its server certificate.

    config PROJECT_SKIP_COMMON_NAME_CHECK
        bool "Skip server certificate CN fieldcheck"
        default n
        help
            This allows you to skip the validation of OTA server certificate CN field.
endmenu

menu "MQTT Configuration"

    config BROKER_URL
        string "Broker URL"
        default "mqtt://mqtt.eclipseprojects.io"
        help
            URL of the broker to connect to
endmenu
```
